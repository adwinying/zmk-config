#include <dt-bindings/zmk/matrix_transform.h>

/ {
	chosen {
		zmk,kscan = &kscan0;
	};

	kscan0: kscan_0 {
		compatible = "zmk,kscan-gpio-direct";

		label = "KSCAN";

		input-gpios =
      <&pro_micro_d  4 (GPIO_ACTIVE_LOW | GPIO_PULL_UP)>,
      <&pro_micro_d  5 (GPIO_ACTIVE_LOW | GPIO_PULL_UP)>,
      <&pro_micro_d  6 (GPIO_ACTIVE_LOW | GPIO_PULL_UP)>,
      <&pro_micro_d 15 (GPIO_ACTIVE_LOW | GPIO_PULL_UP)>,
      <&pro_micro_d  7 (GPIO_ACTIVE_LOW | GPIO_PULL_UP)>,
      <&pro_micro_d  8 (GPIO_ACTIVE_LOW | GPIO_PULL_UP)>,
      <&pro_micro_d  9 (GPIO_ACTIVE_LOW | GPIO_PULL_UP)>,
      <&pro_micro_d 14 (GPIO_ACTIVE_LOW | GPIO_PULL_UP)>;
	};
};
