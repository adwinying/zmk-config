## boards/shields/two_by_four/Kconfig.defconfig
```kconfig
if SHIELD_TWO_BY_FOUR_LEFT || SHIELD_TWO_BY_FOUR_RIGHT

config ZMK_KEYBOARD_NAME
	default "TwoByFour"

endif
```

## boards/shields/two_by_four/Kconfig.shield
```kconfig
config SHIELD_TWO_BY_FOUR_LEFT
	def_bool $(shields_list_contains, two_by_four_left)

config SHIELD_TWO_BY_FOUR_RIGHT
	def_bool $(shields_list_contains, two_by_four_right)
```
